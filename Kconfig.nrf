## Kconfig.nrf
```kconfig
#
# Copyright (c) 2018 Nordic Semiconductor
#
# SPDX-License-Identifier: LicenseRef-Nordic-5-Clause
#

menu "Nordic nRF Connect"

rsource "drivers/Kconfig"
rsource "lib/Kconfig"
rsource "subsys/Kconfig"

# Symbols normally defined by Nordics Zephyr fork and referenced by sdk-nrfxlib
config PSA_WANT_ALG_CTR_DRBG
	bool
	prompt "PSA RNG using CTR_DRBG"
	help
	  Provide CTR_DRBG as the random number generator.
	  Note: This configuration is currently not described and has no effect.

config PSA_WANT_ALG_HMAC_DRBG
	bool
	prompt "PSA RNG using HMAC_DRBG"
	help
	  Provide HMAC_DRBG as the random number generator.
	  Note: This configuration is currently not described and has no effect.

endmenu
```

## drivers/Kconfig
```kconfig
#
# Copyright (c) 2018-2020 Nordic Semiconductor ASA
#
# SPDX-License-Identifier: LicenseRef-Nordic-5-Clause
#

menu "Device Drivers"

rsource "bluetooth/Kconfig"
rsource "entropy/Kconfig"
rsource "serial/Kconfig"

rsource "wifi/Kconfig"

if MPSL
rsource "mpsl/Kconfig"
endif

endmenu
```

## subsys/bluetooth/Kconfig
```kconfig
#
# Copyright (c) 2018 Nordic Semiconductor
#
# SPDX-License-Identifier: LicenseRef-Nordic-5-Clause
#

menu "Bluetooth Low Energy"

if BT

# BT_MAX_CONN is declared in Zephyr, here we add the range and default for
# BT_LL_SOFTDEVICE which is tested with 20 connections.
# When both connection roles are enabled there has to be one for each role.
config BT_MAX_CONN
	int
	range 2 20 if BT_LL_SOFTDEVICE && BT_CENTRAL && BT_PERIPHERAL
	range 1 20 if BT_LL_SOFTDEVICE
	default 2 if BT_LL_SOFTDEVICE && BT_CENTRAL && BT_PERIPHERAL

config BT_LL_SOFTDEVICE_HEADERS_INCLUDE
	bool
	default y if !BT_CTLR
	help
	  Include SoftDevice header files provided with the library.

if BT_CTLR
rsource "controller/Kconfig"
endif

endif # BT

endmenu
```

## west.yml
```yaml
manifest:
  defaults:
    remote: nrfconnect

  remotes:
    - name: nrfconnect
      url-base: https://github.com/nrfconnect
  projects:
    - name: sdk-nrfxlib
      path: modules/lib/sdk-nrfxlib
      revision: v2.5.0
    - name: sdk-hostap
      path: modules/lib/hostap
      revision: d82c309c2e7eea5f08bbc1ac9e2f4c4622fbe998
```
